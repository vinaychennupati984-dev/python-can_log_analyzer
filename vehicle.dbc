VERSION ""

NS_ :

BS_:

BU_: ECU1

BO_ 256 SpeedMessage: 8 ECU1
 SG_ Speed : 0|16@1+ (0.1,0) [0|250] "km/h" ECU1
 SG_ Temperature : 16|8@1+ (1,0) [0|120] "C" ECU1
